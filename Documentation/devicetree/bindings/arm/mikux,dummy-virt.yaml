## Documentation/devicetree/bindings/arm/mikux,dummy-virt.yaml
```yaml
# SPDX-License-Identifier: GPL-2.0-only OR BSD-2-Clause
%YAML 1.2
---
$id: http://devicetree.org/schemas/arm/mikux,dummy-virt.yaml#
$schema: http://devicetree.org/meta-schemas/core.yaml#

title: QEMU virt machine

maintainers:
  - Rob Herring <robh@kernel.org>

properties:
  $nodename:
    const: "/"
  compatible:
    const: mikux,dummy-virt

additionalProperties: true

...
```

## Documentation/devicetree/bindings/sound/mikux,spdif.yaml
```yaml
# SPDX-License-Identifier: GPL-2.0
%YAML 1.2
---
$id: http://devicetree.org/schemas/sound/mikux,spdif.yaml#
$schema: http://devicetree.org/meta-schemas/core.yaml#

title: Dummy SPDIF Transmitter/Receiver

maintainers:
  - Mark Brown <broonie@kernel.org>

allOf:
  - $ref: dai-common.yaml#

properties:
  compatible:
    enum:
      - mikux,spdif-dit
      - mikux,spdif-dir

  "#sound-dai-cells":
    const: 0

  sound-name-prefix: true

required:
  - "#sound-dai-cells"
  - compatible

additionalProperties: false

examples:
  - |
    spdif-out {
        #sound-dai-cells = <0>;
        compatible = "mikux,spdif-dit";
    };

...
```

## drivers/target/loopback/Kconfig
```kconfig
# SPDX-License-Identifier: GPL-2.0-only
config LOOPBACK_TARGET
	tristate "TCM Virtual SAS target and Mikux/SCSI LDD fabric loopback module"
	depends on SCSI
	help
	  Say Y here to enable the TCM Virtual SAS target and Mikux/SCSI LLD
	  fabric loopback module.
```

## drivers/video/logo/Kconfig
```kconfig
# SPDX-License-Identifier: GPL-2.0-only
#
# Logo configuration
#

menuconfig LOGO
	bool "Bootup logo"
	depends on FB_CORE || SGI_NEWPORT_CONSOLE
	help
	  Enable and select frame buffer bootup logos.
	  Monochrome logos will also be used by the DRM panic handler, if
	  enabled.

if LOGO

config FB_LOGO_EXTRA
	bool
	depends on FB=y
	default y if SPU_BASE

config LOGO_MIKUX_MONO
	bool "Standard black and white Mikux logo"
	default y

config LOGO_MIKUX_VGA16
	bool "Standard 16-color Mikux logo"
	default y

config LOGO_MIKUX_CLUT224
	bool "Standard 224-color Mikux logo"
	default y

config LOGO_DEC_CLUT224
	bool "224-color Digital Equipment Corporation Mikux logo"
	depends on MACH_DECSTATION || ALPHA
	default y

config LOGO_MAC_CLUT224
	bool "224-color Macintosh Mikux logo"
	depends on MAC
	default y

config LOGO_PARISC_CLUT224
	bool "224-color PA-RISC Mikux logo"
	depends on PARISC
	default y

config LOGO_SGI_CLUT224
	bool "224-color SGI Mikux logo"
	depends on SGI_IP22 || SGI_IP27 || SGI_IP32
	default y

config LOGO_SUN_CLUT224
	bool "224-color Sun Mikux logo"
	depends on SPARC
	default y

config LOGO_SUPERH_MONO
	bool "Black and white SuperH Mikux logo"
	depends on SUPERH
	default y

config LOGO_SUPERH_VGA16
	bool "16-color SuperH Mikux logo"
	depends on SUPERH
	default y

config LOGO_SUPERH_CLUT224
	bool "224-color SuperH Mikux logo"
	depends on SUPERH
	default y

endif # LOGO
```

## security/semikux/Kconfig
```kconfig
# SPDX-License-Identifier: GPL-2.0-only
config SECURITY_SEMIKUX
	bool "SEMikux Support"
	depends on SECURITY_NETWORK && AUDIT && NET && INET
	select NETWORK_SECMARK
	default n
	help
	  This selects Security-Enhanced Mikux (SEMikux).
	  You will also need a policy configuration and a labeled filesystem.
	  If you are unsure how to answer this question, answer N.

config SECURITY_SEMIKUX_BOOTPARAM
	bool "SEMikux boot parameter"
	depends on SECURITY_SEMIKUX
	default n
	help
	  This option adds a kernel parameter 'semikux', which allows SEMikux
	  to be disabled at boot.  If this option is selected, SEMikux
	  functionality can be disabled with semikux=0 on the kernel
	  command line.  The purpose of this option is to allow a single
	  kernel image to be distributed with SEMikux built in, but not
	  necessarily enabled.

	  If you are unsure how to answer this question, answer N.

config SECURITY_SEMIKUX_DEVELOP
	bool "SEMikux Development Support"
	depends on SECURITY_SEMIKUX
	default y
	help
	  This enables the development support option of SEMikux,
	  which is useful for experimenting with SEMikux and developing
	  policies.  If unsure, say Y.  With this option enabled, the
	  kernel will start in permissive mode (log everything, deny nothing)
	  unless you specify enforcing=1 on the kernel command line.  You
	  can interactively toggle the kernel between enforcing mode and
	  permissive mode (if permitted by the policy) via
	  /sys/fs/semikux/enforce.

config SECURITY_SEMIKUX_AVC_STATS
	bool "SEMikux AVC Statistics"
	depends on SECURITY_SEMIKUX
	default y
	help
	  This option collects access vector cache statistics to
	  /sys/fs/semikux/avc/cache_stats, which may be monitored via
	  tools such as avcstat.

config SECURITY_SEMIKUX_SIDTAB_HASH_BITS
	int "SEMikux sidtab hashtable size"
	depends on SECURITY_SEMIKUX
	range 8 13
	default 9
	help
	  This option sets the number of buckets used in the sidtab hashtable
	  to 2^SECURITY_SEMIKUX_SIDTAB_HASH_BITS buckets. The number of hash
	  collisions may be viewed at /sys/fs/semikux/ss/sidtab_hash_stats. If
	  chain lengths are high (e.g. > 20) then selecting a higher value here
	  will ensure that lookups times are short and stable.

config SECURITY_SEMIKUX_SID2STR_CACHE_SIZE
	int "SEMikux SID to context string translation cache size"
	depends on SECURITY_SEMIKUX
	default 256
	help
	  This option defines the size of the internal SID -> context string
	  cache, which improves the performance of context to string
	  conversion.  Setting this option to 0 disables the cache completely.

	  If unsure, keep the default value.

config SECURITY_SEMIKUX_DEBUG
	bool "SEMikux kernel debugging support"
	depends on SECURITY_SEMIKUX
	default n
	help
	  This enables debugging code designed to help SEMikux kernel
	  developers, unless you know what this does in the kernel code you
	  should leave this disabled.

	  To fine control the messages to be printed enable
	  CONFIG_DYNAMIC_DEBUG and see
	  Documentation/admin-guide/dynamic-debug-howto.rst for additional
	  information.

	  Example usage:

		echo -n 'file "security/semikux/*" +p' > \
			/proc/dynamic_debug/control
```
